## samples/certification/sample.yaml
```yaml
sample:
  name: KNX IoT Certification
  description: KNX IoT EITT certification device sample
common:
  sysbuild: true
  build_only: true
  integration_platforms:
    - nrf54l15dk/nrf54l15/cpuapp
    - nrf54lc10dk/nrf54lc10a/cpuapp
    - nrf54lm20dk/nrf54lm20a/cpuapp
    - nrf54lm20dk/nrf54lm20b/cpuapp
  platform_allow:
    - nrf54l15dk/nrf54l15/cpuapp
    - nrf54lc10dk/nrf54lc10a/cpuapp
    - nrf54lm20dk/nrf54lm20a/cpuapp
    - nrf54lm20dk/nrf54lm20b/cpuapp
  tags:
    - ci_build
tests:
  # Default: commissioning by the EITT + automatic Thread Joiner.
  samples.knx_iot.certification: {}
  samples.knx_iot.certification.thread_otshell:
    extra_args:
      - EXTRA_CONF_FILE=../common/overlay-thread-otshell.conf
  # MCUboot and KNX IoT software update. The nRF54LC10 slots are too small.
  samples.knx_iot.certification.swu:
    extra_args:
      - SB_EXTRA_CONF_FILE=../common/sysbuild-swu.conf
    platform_exclude:
      - nrf54lc10dk/nrf54lc10a/cpuapp
  samples.knx_iot.certification.verbose_logging:
    required_snippets:
      - knx-verbose-logging
```

## samples/light_switch_actuator/sample.yaml
```yaml
sample:
  name: KNX IoT Light Switch Actuator
  description: KNX IoT light switch actuator sample
common:
  sysbuild: true
  build_only: true
  integration_platforms:
    - nrf54l15dk/nrf54l15/cpuapp
    - nrf54lm20dk/nrf54lm20a/cpuapp
    - nrf54lm20dk/nrf54lm20b/cpuapp
  platform_allow:
    - nrf54l15dk/nrf54l15/cpuapp
    - nrf54lm20dk/nrf54lm20a/cpuapp
    - nrf54lm20dk/nrf54lm20b/cpuapp
  tags:
    - ci_build
tests:
  # Default: ETS6 commissioning + automatic Thread Joiner.
  samples.knx_iot.light_switch_actuator: {}
  samples.knx_iot.light_switch_actuator.release:
    extra_args:
      - FILE_SUFFIX=release
  samples.knx_iot.light_switch_actuator.knx_hardcoded:
    extra_args:
      - EXTRA_CONF_FILE=../common/overlay-knx-hardcoded.conf
  samples.knx_iot.light_switch_actuator.thread_hardcoded:
    extra_args:
      - EXTRA_CONF_FILE=../common/overlay-thread-hardcoded.conf
  samples.knx_iot.light_switch_actuator.thread_otshell:
    extra_args:
      - EXTRA_CONF_FILE=../common/overlay-thread-otshell.conf
  samples.knx_iot.light_switch_actuator.hardcoded:
    extra_args:
      - EXTRA_CONF_FILE=../common/overlay-knx-hardcoded.conf;../common/overlay-thread-hardcoded.conf
```

## samples/light_switch_sensor/sample.yaml
```yaml
sample:
  name: KNX IoT Light Switch Sensor
  description: KNX IoT light switch sensor sample
common:
  sysbuild: true
  build_only: true
  integration_platforms:
    - nrf54l15dk/nrf54l15/cpuapp
    - nrf54lm20dk/nrf54lm20a/cpuapp
    - nrf54lm20dk/nrf54lm20b/cpuapp
  platform_allow:
    - nrf54l15dk/nrf54l15/cpuapp
    - nrf54lm20dk/nrf54lm20a/cpuapp
    - nrf54lm20dk/nrf54lm20b/cpuapp
  tags:
    - ci_build
tests:
  # Default: ETS6 commissioning + automatic Thread Joiner.
  samples.knx_iot.light_switch_sensor: {}
  samples.knx_iot.light_switch_sensor.release:
    extra_args:
      - FILE_SUFFIX=release
  samples.knx_iot.light_switch_sensor.knx_hardcoded:
    extra_args:
      - EXTRA_CONF_FILE=../common/overlay-knx-hardcoded.conf
  samples.knx_iot.light_switch_sensor.thread_hardcoded:
    extra_args:
      - EXTRA_CONF_FILE=../common/overlay-thread-hardcoded.conf
  samples.knx_iot.light_switch_sensor.thread_otshell:
    extra_args:
      - EXTRA_CONF_FILE=../common/overlay-thread-otshell.conf
  samples.knx_iot.light_switch_sensor.hardcoded:
    extra_args:
      - EXTRA_CONF_FILE=../common/overlay-knx-hardcoded.conf;../common/overlay-thread-hardcoded.conf
```

## subsys/Kconfig
```kconfig
#
# Copyright (c) 2026 Nordic Semiconductor ASA
#
# SPDX-License-Identifier: LicenseRef-Nordic-5-Clause
#

menuconfig KNX_IOT_ADD_ON
	bool "KNX IoT stack"
	select KNXIOT_LIB
	# PSA Crypto surface used by SPAKE2+ / ECDSA enrollment.
	select REQUIRES_FULL_LIBC
	select FPU
	select PSA_WANT_KEY_TYPE_ECC_PUBLIC_KEY
	select PSA_WANT_KEY_TYPE_ECC_KEY_PAIR_IMPORT
	select PSA_WANT_KEY_TYPE_ECC_KEY_PAIR_EXPORT
	select PSA_WANT_ECC_SECP_R1_256
	select PSA_WANT_ALG_ECDSA
	select PSA_WANT_ALG_SHA_256
	select PSA_WANT_ALG_HMAC
	select PSA_WANT_ALG_HKDF
	select PSA_WANT_ALG_PBKDF2_HMAC
	# tinycbor headers pull in NETWORKING even though we don't use the IP stack as an L2.
	imply NETWORKING
	imply POSIX_API
	imply CPP
	imply FLASH
	imply FLASH_MAP
	imply SETTINGS
	imply MBEDTLS
	imply MBEDTLS_ENABLE_HEAP
	imply MBEDTLS_PSA_CRYPTO_C
	help
	  Enable the KNX IoT add-on. This brings in the third-party KNX IoT
	  stack (libknx) together with the add-on's shared KNX integration library
	  under subsys/knx/.

if KNX_IOT_ADD_ON

choice KNX_COMMISSIONING
	prompt "KNX commissioning method"
	default KNX_ETS_COMMISSIONING
	help
	  Select how KNX configuration is applied.

config KNX_ETS_COMMISSIONING
	bool "ETS6 commissioning"
	help
	  Configure the device from ETS6 over Thread.

config KNX_HARDCODED_COMMISSIONING
	bool "Hardcoded commissioning"
	help
	  Apply a fixed KNX configuration on boot.

endchoice

config KNX_IOT_PASSWORD
	string "KNX IoT SPAKE2+ password"
	default "2X4W3TE0DFLLS19Y1FCH"
	help
	  Password used to generate the SPAKE2+ verifier record at build time.
	  The generated record, is used by the stack during authentication.
	  The sample keeps the password in the image so its shell can print
	  the onboarding QR code.

config KNX_PROGRAMMING_MODE_AUTOSTART
	bool "Automatically enable programming mode for uncommissioned devices"
	default n
	help
	  Enable KNX programming mode after an uncommissioned device joins the
	  Thread network. Programming mode is automatically disabled after the
	  configured timeout or when ETS clears it.

config KNX_PROGRAMMING_MODE_AUTOSTART_TIMEOUT_MINUTES
	int "Programming mode autostart timeout (minutes)"
	default 5
	range 1 60
	help
	  Maximum time an uncommissioned device remains discoverable in KNX
	  programming mode after it joins the Thread network.

config KNX_THREAD_PRIORITY
	int "KNX event-loop thread priority"
	default 5
	help
	  Scheduling priority of the KNX worker thread that runs the stack
	  event loop (oc_main_poll). A preemptible (positive) priority is the
	  usual choice so networking and system work can run alongside it. The
	  thread's stack size is taken from KNX_THREAD_STACK_SIZE.

config KNX_THREAD_STACK_SIZE
	int "KNX event-loop thread stack size"
	default 12288
	help
	  Stack size of the KNX worker thread that runs the stack event loop
	  (oc_main_poll). The loop reaches into the stack's CoAP and OSCORE
	  paths, whose buffers dominate the requirement.

config KNX_VERBOSE_STACK_LOGS
	bool "Verbose libknx stack logging"
	default n
	help
	  When enabled, libknx logs at DEBUG level and stack PRINT output is
	  routed to Zephyr logging.

endif # KNX_IOT_ADD_ON
```

## subsys/ui/Kconfig
```kconfig
#
# Copyright (c) 2026 Nordic Semiconductor ASA
#
# SPDX-License-Identifier: LicenseRef-Nordic-5-Clause
#

menu "Board user interface"
	depends on DK_LIBRARY

choice KNX_UI_LAYOUT
	prompt "Board user interface layout"
	default KNX_UI_LAYOUT_SINGLE_BUTTON_RGB if BOARD_NRF54L15TAG
	default KNX_UI_LAYOUT_DK
	help
	  Select how device state is shown on the board LEDs and how button
	  presses map to Thread, KNX, and application actions.

config KNX_UI_LAYOUT_DK
	bool "Development kit (four LEDs, four buttons)"
	help
	  Dedicated status LEDs for Thread and KNX, a dedicated button for
	  Thread actions and for KNX actions, two application buttons and
	  LEDs.

config KNX_UI_LAYOUT_SINGLE_BUTTON_RGB
	bool "Single button and RGB LED"
	help
	  One RGB LED shows the current commissioning stage in a different
	  colour, and one button performs the action relevant to that stage.
	  The devicetree must provide the knx-ui-rgb-led alias pointing to a
	  leds-group-multicolor node, and the sw0 alias for the button.

endchoice

endmenu
```
