/*
 * Copyright (c) 2026 Nordic Semiconductor ASA
 *
 * SPDX-License-Identifier: LicenseRef-Nordic-5-Clause
 */

/*
 * KNX Stack sends a lot of logs speed needs to be increased to avoid dropping them.
 */

&uart20 {
	current-speed = <1000000>;
};
