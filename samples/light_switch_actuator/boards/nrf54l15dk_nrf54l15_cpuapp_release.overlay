/*
 * Copyright (c) 2026 Nordic Semiconductor ASA
 *
 * SPDX-License-Identifier: LicenseRef-Nordic-5-Clause
 */

#include <knx_iot/nrf54l15_cpuapp_partitions.dtsi>

/* Disable unused peripherals */
&spi00 {
	status = "disabled";
};

&uart20 {
	status = "disabled";
};
