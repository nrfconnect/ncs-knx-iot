## west.yml
```yaml
# Copyright (c) 2026 Nordic Semiconductor ASA
# SPDX-License-Identifier: Apache-2.0

manifest:
  remotes:
    - name: ncs
      url-base: https://github.com/nrfconnect

  defaults:
    remote: ncs

  projects:
    - name: nrf
      remote: ncs
      repo-path: sdk-nrf
      revision: v3.4.0
      import: true

    - name: sdk-knx-iot-stack
      revision: zephyr_port
      remote: ncs
      repo-path: sdk-knx-iot-point-api-stack
      path: modules/lib/sdk-knx-iot-stack
      submodules:
        - path: deps/tinycbor
```
